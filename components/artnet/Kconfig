## components/artnet/Kconfig
```kconfig
menu "qmsk-artnet"
  config ARTNET_OUTPUTS_MAX
      int "Maximum Art-NET output universes"

      range 0 24
      default 4
      help
          Must be less than CONFIG_LWIP_UDP_RECVMBOX_SIZE and CONFIG_LWIP_TCPIP_RECVMBOX_SIZE to avoid dropped packets.

endmenu
```

## components/leds/Kconfig
```kconfig
menu "qmsk-leds"
  config LEDS_GPIO_ENABLED
      bool "Enable GPIO output interface multiplexing"

      default y if IDF_TARGET="esp8266"
      default n

  config LEDS_SPI_ENABLED
      bool "Enable SPI output interface"

      default y if IDF_TARGET="esp8266"
      default y if IDF_TARGET="esp32"
      default n

  config LEDS_UART_ENABLED
      bool "Enable UART output interface"

      default y if IDF_TARGET="esp8266"
      default y if IDF_TARGET="esp32"
      default n

  config LEDS_I2S_ENABLED
      bool "Enable I2S output interface"

      default y if IDF_TARGET="esp8266"
      default y if IDF_TARGET="esp32"
      default n

endmenu
```

## components/spiffsgen/Kconfig
```kconfig
menu "SPIFFS Configuration"
    config SPIFFS_FOLLOW_SYMLINKS
        bool "Enable symbolic links for image creation"
        default "n"
        help
            If this option is enabled, symbolic links are taken into account
            during partition image creation.

endmenu
```

## components/usb_pd_sink/Kconfig
```kconfig
menu "STUSB4500"
  config STUSB4500_SNK_PDO_NUMB
    int "Number of sink PDOs"
    range 1 3
    default 3

  config STUSB4500_V_SNK_PDO2
    int "Voltage value for SNK_PDO2 (mV)"
    range 5000 20000
    default 15000

  config STUSB4500_V_SNK_PDO3
    int "Voltage value for SNK_PDO3 (mV)"
    range 5000 20000
    default 20000

  config STUSB4500_I_SNK_PDO1
    int "Current value for SNK_PDO1 (mA)"
    range 500 5000
    default 1500

  config STUSB4500_I_SNK_PDO2
    int "Current value for SNK_PDO2 (mA)"
    range 500 5000
    default 1500

  config STUSB4500_I_SNK_PDO3
    int "Current value for SNK_PDO3 (mA)"
    range 500 5000
    default 1000

  config STUSB4500_VBUS_DISCH_DISABLE
    bool "VBUS discharge deactivation on VBUS_VS_DISCH and DISCH pins"
    default 0

  config STUSB4500_USB_COMM_CAPABLE
    bool "USB 2.0 or 3.x data communication capability by sink system"
    default 0

  config STUSB4500_SNK_UNCONS_POWER
    bool "Unconstrained Power bit setting in capabilities message sent by the sink"
    default 0

  config STUSB4500_REQ_SRC_CURRENT
    bool "Request maximum available source current from source"
    default 0

  choice STUSB4500_POWER_OK_CFG_CHOICE
    prompt "Selects POWER_OK pins configuration"
    default STUSB4500_POWER_OK_CFG_2

    config STUSB4500_POWER_OK_CFG_1
      bool "Configuration 1"

    config STUSB4500_POWER_OK_CFG_2
      bool "Configuration 2"

    config STUSB4500_POWER_OK_CFG_3
      bool "Configuration 2"

  endchoice

  config STUSB4500_POWER_OK_CFG
    int "Selects POWER_OK pins configuration"
    range 0 3
    default 0 if STUSB4500_POWER_OK_CFG_1
    default 2 if STUSB4500_POWER_OK_CFG_2
    default 3 if STUSB4500_POWER_OK_CFG_3

  config STUSB4500_POWER_ONLY_ABOVE_5V
    bool "Only enable VBUS_EN_SNK pin when source attached and voltage is negotiated to PDO2/3"
    default 0

  choice STUSB4500_GPIO_CFG_CHOICE
    prompt "Selects POWER_OK pins configuration"
    default STUSB4500_GPIO_CFG_ERROR_RECOVERY

    config STUSB4500_GPIO_CFG_SW_CTRL_GPIO
      bool "SW_CTRL_GPIO"

    config STUSB4500_GPIO_CFG_ERROR_RECOVERY
      bool "ERROR_RECOVERY"

    config STUSB4500_GPIO_CFG_DEBUG
      bool "DEBUG"

    config STUSB4500_GPIO_CFG_SINK_POWER
      bool "SINK_POWER"

  endchoice

  config STUSB4500_GPIO_CFG
    int "Selects GPIO pin configuration"
    range 0 3
    default 0 if STUSB4500_GPIO_CFG_SW_CTRL_GPIO
    default 1 if STUSB4500_GPIO_CFG_ERROR_RECOVERY
    default 2 if STUSB4500_GPIO_CFG_DEBUG
    default 3 if STUSB4500_GPIO_CFG_SINK_POWER

endmenu
```

## main/Kconfig
```kconfig
menu "qmsk-esp"
  choice STATUS_LEDS_GPIO_TYPE
    prompt "LED/button GPIO type"
    default STATUS_LEDS_GPIO_TYPE_HOST

    config STATUS_LEDS_GPIO_TYPE_HOST
      bool "Host/Internal GPIO"

    config STATUS_LEDS_GPIO_TYPE_I2C_GPIO_0
      depends on I2C_GPIO_ENABLED
      bool "External I2C-GPIO0 expander"

  endchoice


  choice STATUS_LEDS_USER
    prompt "USER LED/button mode"
    default STATUS_LEDS_USER_MODE

    config STATUS_LEDS_USER_DISABLED
      bool "Disabled"

    config STATUS_LEDS_USER_MODE
      bool "User LED"

    config STATUS_LEDS_USER_MODE_TEST
      bool "User LED, Test button"

  endchoice

  config STATUS_LEDS_USER_ENABLED
      bool
      default n if STATUS_LEDS_USER_DISABLED
      default y if STATUS_LEDS_USER_MODE
      default y if STATUS_LEDS_USER_MODE_TEST

  config STATUS_LEDS_USER_GPIO_NUM
      depends on STATUS_LEDS_USER_ENABLED
      int "USER LED GPIO pin"

      default 2   if IDF_TARGET="esp32"
      default 16  if IDF_TARGET="esp8266"

  config STATUS_LEDS_USER_GPIO_INVERTED
      depends on STATUS_LEDS_USER_ENABLED
      bool "USER LED GPIO active-low"

      default y   if IDF_TARGET="esp32"
      default y   if IDF_TARGET="esp8266"


  choice STATUS_LEDS_FLASH
    prompt "FLASH LED/button mode"
    default STATUS_LEDS_FLASH_MODE_ACTIVITY_CONFIG

    config STATUS_LEDS_FLASH_DISABLED
      bool "Disabled"

    config STATUS_LEDS_FLASH_MODE_ACTIVITY
      bool "Activity LED"

    config STATUS_LEDS_FLASH_MODE_ACTIVITY_CONFIG
      bool "Activity LED, Config button"

    config STATUS_LEDS_FLASH_MODE_ALERT_CONFIG
      bool "Alert LED, Config button"

  endchoice

  config STATUS_LEDS_FLASH_ENABLED
      bool
      default n if STATUS_LEDS_FLASH_DISABLED
      default y if STATUS_LEDS_FLASH_MODE_ACTIVITY
      default y if STATUS_LEDS_FLASH_MODE_ACTIVITY_CONFIG
      default y if STATUS_LEDS_FLASH_MODE_ALERT_CONFIG

  config STATUS_LEDS_FLASH_GPIO_NUM
      depends on STATUS_LEDS_FLASH_ENABLED
      int "FLASH LED GPIO pin"
      default 0   if IDF_TARGET="esp8266"
      default 4   if IDF_TARGET="esp32"

  config STATUS_LEDS_FLASH_GPIO_INVERTED
      depends on STATUS_LEDS_FLASH_ENABLED
      bool "FLASH LED GPIO active-low"
      default y   if IDF_TARGET="esp8266"
      default y   if IDF_TARGET="esp32"


  choice STATUS_LEDS_ALERT
    prompt "ALERT LED/button mode"
    default STATUS_LEDS_ALERT_MODE_TEST

    config STATUS_LEDS_ALERT_DISABLED
      bool "Disabled"

    config STATUS_LEDS_ALERT_MODE
      bool "Alert LED"

    config STATUS_LEDS_ALERT_MODE_TEST
      bool "Alert LED, Test button"

  endchoice

  config STATUS_LEDS_ALERT_ENABLED
      bool

      default n if STATUS_LEDS_ALERT_DISABLED
      default y if STATUS_LEDS_ALERT_MODE
      default y if STATUS_LEDS_ALERT_MODE_TEST

  config STATUS_LEDS_ALERT_GPIO_NUM
      depends on STATUS_LEDS_ALERT_ENABLED
      int "ALERT LED GPIO pin"

      default 15  if IDF_TARGET="esp8266" && (ESP_CONSOLE_UART_DEFAULT || ESP_CONSOLE_UART_CUSTOM_NUM_0)
      default 15  if IDF_TARGET="esp32"

  config STATUS_LEDS_ALERT_GPIO_INVERTED
      depends on STATUS_LEDS_ALERT_ENABLED
      bool "ALERT LED GPIO active-low"

      default n   if IDF_TARGET="esp8266"
      default y   if IDF_TARGET="esp32"


  choice STATUS_LEDS_CONFIG
    prompt "CONFIG button mode"
    default STATUS_LEDS_CONFIG_DISABLED

    config STATUS_LEDS_CONFIG_DISABLED
      bool "Disabled"

    config STATUS_LEDS_CONFIG_MODE
      bool "CONFIG button"

  endchoice

  config STATUS_LEDS_CONFIG_ENABLED
      bool

      default n if STATUS_LEDS_CONFIG_DISABLED
      default y if STATUS_LEDS_CONFIG_MODE

  config STATUS_LEDS_CONFIG_GPIO_NUM
      depends on STATUS_LEDS_CONFIG_ENABLED
      int "CONFIG Button GPIO pin"

  config STATUS_LEDS_CONFIG_GPIO_INVERTED
      depends on STATUS_LEDS_CONFIG_ENABLED
      bool "CONFIG Button GPIO active-low"


  choice STATUS_LEDS_TEST
    prompt "TEST button mode"
    default STATUS_LEDS_TEST_DISABLED

    config STATUS_LEDS_TEST_DISABLED
      bool "Disabled"

    config STATUS_LEDS_TEST_MODE
      bool "TEST button"

  endchoice

  config STATUS_LEDS_TEST_ENABLED
      bool

      default n if STATUS_LEDS_TEST_DISABLED
      default y if STATUS_LEDS_TEST_MODE

  config STATUS_LEDS_TEST_GPIO_NUM
      depends on STATUS_LEDS_TEST_ENABLED
      int "TEST Button GPIO pin"

  config STATUS_LEDS_TEST_GPIO_INVERTED
      depends on STATUS_LEDS_TEST_ENABLED
      bool "TEST Button GPIO active-low"

endmenu

menu "qmsk-artnet"
  config ARTNET_ENABLED
      bool "Enable artnet protocol by default"
endmenu

menu "qmsk-esp-eth"
  choice ETH_BOARD
    prompt "Ethernet board type"
    default ETH_BOARD_NONE

    config ETH_BOARD_NONE
      bool "None"

    config ETH_BOARD_WT32_ETH01
      bool "WT32-ETH01"
      select ETH_ENABLED
      select ETH_USE_ESP32_EMAC

    config ETH_BOARD_QMSK_ESP32_LAN87XX
      bool "QMSK-ESP32-LAN87XX"
      select ETH_ENABLED
      select ETH_USE_ESP32_EMAC

  endchoice

  choice ETH_MODE_DEFAULT
      optional
      prompt "Ethernet mode default"
      default ETH_MODE_DEFAULT_DHCP_SERVER

      config ETH_MODE_DEFAULT_STATIC
        bool "Static IPv4"

      config ETH_MODE_DEFAULT_AUTOCONF
        bool "IPv4 autoconf"

      config ETH_MODE_DEFAULT_DHCP_CLIENT
        bool "DHCP Client"

      config ETH_MODE_DEFAULT_DHCP_SERVER
        bool "DHCP Server"

  endchoice

  config ETH_IP_DEFAULT
      string "IPv4 address"
      default "192.168.5.1"

  config ETH_NETMASK_DEFAULT
      string "IPv4 netmask"
      default "255.255.255.0"

  config ETH_GW_DEFAULT
      string "IPv4 gateway"
      default "0.0.0.0"

  config ETH_MAC_MDC_GPIO_NUM
      depends on ETH_ENABLED
      int

      default 23  if ETH_BOARD_WT32_ETH01
      default 23  if ETH_BOARD_QMSK_ESP32_LAN87XX
      default 23

  config ETH_MAC_MDIO_GPIO_NUM
      depends on ETH_ENABLED
      int

      default 18  if ETH_BOARD_WT32_ETH01
      default 18  if ETH_BOARD_QMSK_ESP32_LAN87XX
      default 18

  config ETH_PHY_LAN87XX
      depends on ETH_ENABLED
      bool

      default y if ETH_BOARD_WT32_ETH01
      default y if ETH_BOARD_QMSK_ESP32_LAN87XX
      default n

  config ETH_PHY_ADDR
      depends on ETH_ENABLED
      int

      default  1  if ETH_BOARD_WT32_ETH01
      default  1  if ETH_BOARD_QMSK_ESP32_LAN87XX
      default -1

  config ETH_PHY_RESET_GPIO_NUM
      depends on ETH_ENABLED
      int

      default  16 if ETH_BOARD_WT32_ETH01
      default -1
endmenu

menu "qmsk-esp-i2c"
  config I2C_MASTER_ENABLED
    prompt "Use I2C bus for IO peripherals"
    bool

  config I2C_MASTER_SDA_IO_NUM
    depends on I2C_MASTER_ENABLED
    int
    prompt "IO pin for I2C SDA"

    default 15 if IDF_TARGET="esp32"

  config I2C_MASTER_SCL_IO_NUM
    depends on I2C_MASTER_ENABLED
    int
    prompt "IO pin for I2C SCL"

    default 2 if IDF_TARGET="esp32"

  config I2C_MASTER_INTERNAL_PULLUP_ENABLED
    depends on I2C_MASTER_ENABLED
    bool
    prompt "Enable internal pull-up"

    default false

  config I2C_MASTER_CLK_SPEED
    depends on I2C_MASTER_ENABLED
    int
    prompt "Clock frequency"

    default 400000

  config I2C_GPIO_ENABLED
    select I2C_MASTER_ENABLED
    prompt "Use I2C GPIO expanders"
    bool

  choice I2C_GPIO_TYPE
    depends on I2C_GPIO_ENABLED
    prompt "Primary I2C GPIO type"

    config I2C_GPIO_TYPE_NONE
      bool "No external I2C GPIO expander"

    config I2C_GPIO_TYPE_PCA9534
      depends on I2C_GPIO_ENABLED
      bool "External I2C PCA9534 GPIO expander"

    config I2C_GPIO_TYPE_PCA9554
      depends on I2C_GPIO_ENABLED
      bool "External I2C PCA9554 GPIO expander"

  endchoice

  config I2C_GPIO_ADDR_PCA9534
    depends on I2C_GPIO_TYPE_PCA9534
    int "Configurable I2C address bits (0-16)"
    range 0 15
    default 0

  config I2C_GPIO_ADDR_PCA9554
    depends on I2C_GPIO_TYPE_PCA9554
    int "Configurable I2C address bits (0-16)"
    range 0 15
    default 0

  config I2C_GPIO_INT_PIN
    depends on I2C_GPIO_TYPE_PCA9534 || I2C_GPIO_TYPE_PCA9554
    int "HOST GPIO pin for I2C bus interrupt, 0 to disable"
    range 0 39
    default 0

endmenu

menu "qmsk-esp-sdcard"
  choice SDCARD_HOST
    prompt "SD Card host type"

    config SDCARD_HOST_NONE
      bool "Disabled"

    config SDCARD_SPI_HOST
      bool "SD Card SPI Host"
      select SDCARD_ENABLED

  endchoice

  config SDCARD_SPI_MOSI_PIN
    depends on SDCARD_SPI_HOST
    int "HOST IO pin for SDSPI CMD/MOSI"
    range 0 39
    default 15

  config SDCARD_SPI_MISO_PIN
    depends on SDCARD_SPI_HOST
    int "HOST IO pin for SDSPI D0/MSIO"
    range 0 39
    default 2

  config SDCARD_SPI_SCLK_PIN
    depends on SDCARD_SPI_HOST
    int "HOST IO pin for SDSPI CLK/SCLK"
    range 0 39
    default 14

  config SDCARD_SPI_CS_PIN
    depends on SDCARD_SPI_HOST
    int "HOST IO pin for SDSPI D3/CS"
    range 0 39
    default 13

  choice SDCARD_SPI_CD
    prompt "SD Card Detect"
    optional

    config SDCARD_SPI_CD_HOST
      bool "SD Card Detect Host GPIO"

  endchoice

  choice SDCARD_SPI_CD_POL
    depends on SDCARD_SPI_CD_HOST
    prompt "SD Card Detect"
    optional

    config SDCARD_SPI_CD_POL_NO
      bool "normally-open signal to GND for SPI CD"

    config SDCARD_SPI_CD_POL_NC
      bool "normally-closed signal to GND for SPI CD"

  endchoice

  config SDCARD_SPI_CD_PIN
    depends on SDCARD_SPI_CD_HOST
    int "HOST IO pin for SPI CD"
    range 0 39

  config SDCARD_SPI_MAX_FREQ_KHZ
    depends on SDCARD_SPI_HOST
    int "Maximum SPI bus clock"
    range 10000 40000
    default 20000

  config SDCARD_ENABLED
    bool "SD Card support"

endmenu
```

## projects/esp32/sdkconfig.defaults
```kconfig
# Use flash 80Mhz qio mode
CONFIG_ESPTOOLPY_FLASHMODE_QIO=y
CONFIG_ESPTOOLPY_FLASHFREQ_80M=y
CONFIG_ESPTOOLPY_FLASHSIZE_4MB=y

# Use custom stdio VFS
CONFIG_VFS_USE_STDIO=y

# Reduce stack usage for logging
CONFIG_NEWLIB_NANO_FORMAT=y

# Use custom partition table
CONFIG_PARTITION_TABLE_CUSTOM=y
CONFIG_PARTITION_TABLE_CUSTOM_FILENAME="partitions.csv"
CONFIG_PARTITION_TABLE_FILENAME="partitions.csv"

# Use FreeRTOS task stats
CONFIG_FREERTOS_USE_TRACE_FACILITY=y
CONFIG_FREERTOS_GENERATE_RUN_TIME_STATS=y
CONFIG_FREERTOS_VTASKLIST_INCLUDE_COREID=y

# Configure WiFi at boot
CONFIG_ESP_NETIF_TCPIP_ADAPTER_COMPATIBLE_LAYER=n

CONFIG_ESP32_WIFI_NVS_ENABLED=n

# Run TCP/IP stack on cpu0
CONFIG_ESP_MAIN_TASK_AFFINITY_CPU0=y
CONFIG_ESP_MAIN_TASK_AFFINITY=0x0

# Optimize memory usage
CONFIG_MDNS_TASK_STACK_SIZE=2048

# Do not enable ETH by default
CONFIG_ETH_ENABLED=n
CONFIG_ETH_USE_ESP32_EMAC=n
CONFIG_ETH_USE_SPI_ETHERNET=n
CONFIG_ETH_USE_OPENETH=n

## Art-Net
CONFIG_ARTNET_OUTPUTS_MAX=16

# Tune ethernet -> lwip receive stack to handle UDP bursts for 16 artnet universes
CONFIG_ETH_DMA_BUFFER_SIZE=1600
CONFIG_ETH_DMA_RX_BUFFER_NUM=20
CONFIG_ETH_DMA_TX_BUFFER_NUM=10

# critically important for handling UDP bursts
# the default =6 causes the majority of packets to be dropped for artnet universes >6
CONFIG_LWIP_UDP_RECVMBOX_SIZE=20
```
