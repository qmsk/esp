## projects/esp8266/main/Kconfig
```kconfig
menu "qmsk-esp"
  choice STATUS_LEDS_USER
    prompt "USER LED/button mode"
    default STATUS_LEDS_USER_MODE

    config STATUS_LEDS_USER_DISABLED
      bool "Disabled"

    config STATUS_LEDS_USER_MODE
      bool "User LED"

    config STATUS_LEDS_USER_MODE_TEST
      bool "User LED, Test button"

  endchoice

  config STATUS_LEDS_USER_ENABLED
      bool
      default n if STATUS_LEDS_USER_DISABLED
      default y if STATUS_LEDS_USER_MODE
      default y if STATUS_LEDS_USER_MODE_TEST

  choice STATUS_LEDS_USER_GPIO
    prompt "USER LED/button GPIO"
    default STATUS_LEDS_USER_GPIO_16

    config STATUS_LEDS_USER_GPIO_16
      bool "GPIO16 (active-low)"
      help
        ESP8266 RTC GPIO with integrated LED on NodeMCU.

        Active-low with external pull-up and LED from +3V3 on NodeMCU.

  endchoice

  config STATUS_LEDS_USER_GPIO_NUM
      int
      default 16 if STATUS_LEDS_USER_GPIO_16

  config STATUS_LEDS_USER_GPIO_INVERTED
      bool
      default y if STATUS_LEDS_USER_GPIO_16





  choice STATUS_LEDS_FLASH
    prompt "FLASH LED/button mode"
    default STATUS_LEDS_FLASH_MODE_ACTIVITY_CONFIG

    config STATUS_LEDS_FLASH_DISABLED
      bool "Disabled"

    config STATUS_LEDS_FLASH_MODE_ACTIVITY_CONFIG
      bool "Activity LED, Config button"

    config STATUS_LEDS_FLASH_MODE_ALERT_CONFIG
      bool "Alert LED, Config button"

  endchoice

  config STATUS_LEDS_FLASH_ENABLED
      bool
      default n if STATUS_LEDS_FLASH_DISABLED
      default y if STATUS_LEDS_FLASH_MODE_ACTIVITY_CONFIG
      default y if STATUS_LEDS_FLASH_MODE_ALERT_CONFIG

  choice STATUS_LEDS_FLASH_GPIO
    prompt "FLASH LED/button GPIO pin"
    default STATUS_LEDS_FLASH_GPIO_0

    config STATUS_LEDS_FLASH_GPIO_0
      bool "GPIO0 (active-low)"
      help
        ESP8266 strapping pin for selecting FLASH (high) / UART (low) boot mode.

        Active-low with internal weak-pull-up, external pull-up and integrated button to GND on NodeMCU.

  endchoice

  config STATUS_LEDS_FLASH_GPIO_NUM
      int
      default 0 if STATUS_LEDS_FLASH_GPIO_0

  config STATUS_LEDS_FLASH_GPIO_INVERTED
      bool
      default y if STATUS_LEDS_FLASH_GPIO_0





  choice STATUS_LEDS_ALERT
    prompt "ALERT LED/button mode"
    default STATUS_LEDS_ALERT_MODE_TEST

    config STATUS_LEDS_ALERT_DISABLED
      bool "Disabled"

    config STATUS_LEDS_ALERT_MODE
      bool "Alert LED"

    config STATUS_LEDS_ALERT_MODE_TEST
      bool "Alert LED, Test button"

  endchoice

  config STATUS_LEDS_ALERT_ENABLED
      bool

      default n if STATUS_LEDS_ALERT_DISABLED
      default y if STATUS_LEDS_ALERT_MODE_TEST

  choice STATUS_LEDS_ALERT_GPIO
    prompt "GPIO for ALERT LED/button"
    default STATUS_LEDS_ALERT_GPIO_15 if ESP_CONSOLE_UART_DEFAULT || ESP_CONSOLE_UART_CUSTOM_NUM_0

    config STATUS_LEDS_ALERT_GPIO_1
      bool "GPIO1 (active-low)"
      help
        ESP8266 strapping pin for chip_test_mode (active-low).

        Active-low with internal weak-pull-up.

    config STATUS_LEDS_ALERT_GPIO_12
      bool "GPIO12 (active-low)"
      help
        Active-low with internal weak-pull-up on ESP8266.
    config STATUS_LEDS_ALERT_GPIO_13
      bool "GPIO13 (active-low)"
      help
        Active-low with internal weak-pull-up on ESP8266.
    config STATUS_LEDS_ALERT_GPIO_14
      bool "GPIO14 (active-low)"
      help
        Active-low with internal weak-pull-up on ESP8266.

    config STATUS_LEDS_ALERT_GPIO_15
      bool "GPIO15 (active-high)"
      help
        ESP8266 strapping pin for selecting SDIO boot mode.

        Active-high with external pull-down on NodeMCU.

  endchoice

  config STATUS_LEDS_ALERT_GPIO_NUM
      int

      default 1 if STATUS_LEDS_ALERT_GPIO_1
      default 12 if STATUS_LEDS_ALERT_GPIO_12
      default 13 if STATUS_LEDS_ALERT_GPIO_13
      default 14 if STATUS_LEDS_ALERT_GPIO_14
      default 15 if STATUS_LEDS_ALERT_GPIO_15

  config STATUS_LEDS_ALERT_GPIO_INVERTED
      bool

      default y if STATUS_LEDS_ALERT_GPIO_1
      default y if STATUS_LEDS_ALERT_GPIO_12
      default y if STATUS_LEDS_ALERT_GPIO_13
      default y if STATUS_LEDS_ALERT_GPIO_14
      default n if STATUS_LEDS_ALERT_GPIO_15

endmenu
```

## projects/esp8266/sdkconfig.defaults
```kconfig
# CONFIG_ESPTOOLPY_FLASHMODE_QIO is not set
CONFIG_ESPTOOLPY_FLASHMODE_DIO=y
CONFIG_SPI_FLASH_MODE=0x2
# CONFIG_ESPTOOLPY_FLASHSIZE_2MB is not set
CONFIG_ESPTOOLPY_FLASHSIZE_4MB=y
CONFIG_ESPTOOLPY_FLASHSIZE="4MB"
CONFIG_SPI_FLASH_SIZE=0x400000
# CONFIG_PARTITION_TABLE_SINGLE_APP is not set
CONFIG_PARTITION_TABLE_CUSTOM=y
CONFIG_PARTITION_TABLE_FILENAME="partitions.csv"
CONFIG_WIFI_PPT_TASKSTACK_SIZE=4096
CONFIG_ESP_MAIN_TASK_STACK_SIZE=2048
CONFIG_ESP_TIMER_TASK_STACK_SIZE=2048
CONFIG_ESP_CONSOLE_UART_BAUDRATE=115200
CONFIG_FREERTOS_USE_TRACE_FACILITY=y
CONFIG_FREERTOS_USE_STATS_FORMATTING_FUNCTIONS=y
CONFIG_FREERTOS_GENERATE_RUN_TIME_STATS=y
CONFIG_FREERTOS_RUN_TIME_STATS_USING_ESP_TIMER=y
# CONFIG_FREERTOS_RUN_TIME_STATS_USING_CPU_CLK is not set
CONFIG_LWIP_IPV6=y
CONFIG_ENABLE_MDNS=y
# CONFIG_ENABLE_MDNS_CONSOLE is not set
CONFIG_MDNS_MAX_SERVICES=10
CONFIG_NEWLIB_VFS_STDIO=y
# CONFIG_FLASHMODE_QIO is not set
```
